## meta-seneca/conf/layer.conf
```bitbake
# We have a conf and classes directory, add to BBPATH
BBPATH .= ":${LAYERDIR}"

# We have recipes-* directories, add to BBFILES
BBFILES += "${LAYERDIR}/recipes-*/*/*.bb \
            ${LAYERDIR}/recipes-*/*/*.bbappend"

BBFILE_COLLECTIONS += "meta-seneca"
BBFILE_PATTERN_meta-seneca = "^${LAYERDIR}/"
BBFILE_PRIORITY_meta-seneca = "6"

LAYERDEPENDS_meta-seneca = "core"
LAYERSERIES_COMPAT_meta-seneca = "kirkstone"
```
